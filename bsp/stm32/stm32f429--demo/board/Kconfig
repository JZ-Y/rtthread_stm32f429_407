## bsp/stm32/stm32f429--demo/board/Kconfig
```kconfig
menu "Hardware Drivers Config"

config SOC_STM32F429ZI
    bool
    select SOC_SERIES_STM32F4
    select RT_USING_COMPONENTS_INIT
    select RT_USING_USER_MAIN
    default y

menu "Onboard Peripheral Drivers"

   config BSP_USING_ETH
        bool "Enable ETH"
        default n
	if BSP_USING_ETH
		config PHY_USING_DM9161CEP
		bool "DM9161CEP"
		default n
		
		config PHY_USING_LAN8720A
		bool "LAN8720A"
		default n
	
		config PHY_USING_DP83848C
		bool "DP83848C"
		default n

	endif

endmenu

menu "On-chip Peripheral Drivers"

    config BSP_USING_GPIO
        bool "Enable GPIO"
        select RT_USING_PIN
        default y
        
    menuconfig BSP_USING_TIM
        bool "Enable timer"
        default n
        select RT_USING_HWTIMER
        if BSP_USING_TIM
            config BSP_USING_TIM3
                bool "Enable TIM3"
                default n
        endif
        
    menuconfig BSP_USING_UART
        bool "Enable UART"
        default y
        select RT_USING_SERIAL
        if BSP_USING_UART
            config BSP_USING_UART1
                bool "Enable UART1"
                default y

            config BSP_UART1_RX_USING_DMA
                bool "Enable UART1 RX DMA"
                depends on BSP_USING_UART1 && RT_SERIAL_USING_DMA
                default n
                
        endif
        if BSP_USING_UART
            config BSP_USING_UART3
                bool "Enable UART3"
                default y

            config BSP_UART3_RX_USING_DMA
                bool "Enable UART3 RX DMA"
                depends on BSP_USING_UART3 && RT_SERIAL_USING_DMA
                default n
        endif
        
        if BSP_USING_UART
            config BSP_USING_UART4
                bool "Enable UART4"
                default y

            config BSP_UART4_RX_USING_DMA
                bool "Enable UART4 RX DMA"
                depends on BSP_USING_UART4 && RT_SERIAL_USING_DMA
                default n
        endif
        
        if BSP_USING_UART
            config BSP_USING_UART7
                bool "Enable UART7"
                default y

            config BSP_UART7_RX_USING_DMA
                bool "Enable UART7 RX DMA"
                depends on BSP_USING_UART7 && RT_SERIAL_USING_DMA
                default n
        endif
        
    menuconfig BSP_USING_I2C
        bool "Enable I2C BUS"
        default n
        select RT_USING_I2C
        select RT_USING_I2C_BITOPS
        select RT_USING_PIN
        if BSP_USING_I2C
            menuconfig BSP_USING_I2C3
                bool "Enable I2C3 BUS (software simulation)"
                default y
                if BSP_USING_I2C3
                    comment "Notice: PC0 --> 32; PC1 --> 33" 
                    config BSP_I2C3_SCL_PIN
                        int "i2c3 scl pin number"
                        range 1 176
                        default 32
                    config BSP_I2C3_SDA_PIN
                        int "I2C3 sda pin number"
                        range 1 176
                        default 33
                endif            
        endif
        
    source "../libraries/HAL_Drivers/Kconfig"    
    
endmenu

menu "Board extended module Drivers"

endmenu
 
endmenu
```
